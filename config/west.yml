## config/west.yml
```yaml
manifest:
  remotes:
    - name: zmkfirmware
      url-base: https://github.com/zmkfirmware
    - name: Dist16384
      url-base: https://github.com/Dist16384

  projects:
    - name: zmk
      remote: zmkfirmware
      revision: 8de5b120aa1f16a13dd3e6f35a8e07d847307e08
      path: zmk
      import: app/west.yml
    - name: zmk-pmw3610-driver
      remote: Dist16384
      revision: e5f5219e815b87a3f873a0b2b502d92ed597fed1
      path: modules/zmk-pmw3610-driver

  self:
    path: config
```
